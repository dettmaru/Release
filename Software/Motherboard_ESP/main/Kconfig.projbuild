## Software/Motherboard_ESP/main/Kconfig.projbuild
```kconfig
menu "Wifi WPA2 Personal Configuration"

config WIFI_SSID
    string "WiFi SSID"
	default "myssid"
	help
		SSID (network name) for the example to connect to.

config WIFI_PASSWORD
    string "WiFi Password"
	default "myssid"
	help
		WiFi password (WPA or WPA2) for the example to use.

		Can be left blank if the network has no security set.

endmenu

menu "Wifi WPA2 Enterprise Configuration"

config WIFI_SSID
    string "WiFi SSID"
    default "wpa2_test"
    help
        SSID (network name) for the example to connect to.

config EAP_METHOD
    int "EAP METHOD"
    default 1
    help
        EAP method (TLS, PEAP or TTLS) for the example to use.
        TLS: 0, PEAP: 1, TTLS: 2
		
config EAP_ID
    string "EAP ID"
    default "example@espressif.com"
    help
        Identity in phase 1 of EAP procedure.
        
config EAP_USERNAME
    string "EAP USERNAME"
    default "espressif"
    help
        Username for EAP method (PEAP and TTLS).
        
config EAP_PASSWORD
    string "EAP PASSWORD"
    default "test11"
    help
        Password for EAP method (PEAP and TTLS).

endmenu
```
